/* 
 * Linker Script
 * Author: Victor Borges
 *
 * Creation: Mar 12, 2011
 */

/* We generate binary in the ELF format */
OUTPUT_FORMAT("elf32-i386","elf32-i386","elf32-i386");

/* The entry point is _start */
ENTRY(__start);

/* The architecture is x86 */
OUTPUT_ARCH("i386")

SECTIONS
{
  
    /* Kernel is loaded at 0x100000 */
    . = 0x100000;
    __b_load   = .;
    
	/* The multiboot header */
    .multiboot :
    {
		/* Tthe multiboot header */
		*(.multiboot);
		
		/*
		 * The Multiboot header must be contained completely
		 * within the first 8192 bytes of the OS image, and must be
		 * longword (32-bit) aligned.
		 */
		LONG(0);
    }
    
    /* The symbol '__b_kernel mark the begin of the kernel code */
    . = ALIGN(4096);
    __b_kernel = .;
  
    /* Beginning of the text section */
    .text ALIGN(4096) :
    {   
		/* This section includes the code */
        *(.text*)
        *(.gnu.linkonce.t*)
		/* Defines the 'etext' and '_etext' at the end */
        PROVIDE(etext = .);
        PROVIDE(_etext = .);
    }

    /* Beginning of the data section */
    .data . :
    {   
    	*(.data*) 
    	*(.gnu.linkonce.d*)
        PROVIDE(edata = .);
		PROVIDE(_edata = .);
    }

    /* Beginning of the read-only data section */
    .rodata . :
    {   
		start_ctors = .;
		*(.ctor*)
		end_ctors = .;
		
		start_dtors = .;
		*(.dtor*)
		end_dtors = .;
		
		*(.rodata*)
		*(.gnu.linkonce.r*)
        PROVIDE(erodata = .);
        PROVIDE(_erodata = .);
    }
    
    /* We take note of the end of the data to load */
    __e_load = .;

    /* Beginning of the BSS section (global uninitialized data) */
    .bss SIZEOF(.rodata) + ADDR(.rodata) :
    {   
    	*(.bss)
        *(COMMON)
        *(.gnu.linkonce.b*)
        . = ALIGN(4096);
		*(.bootstrap_stack)
        PROVIDE(ebss = .);
		PROVIDE(_ebss = .);
    }

    /* End of the kernel */
    __e_kernel = .;

    /* Discard note, indent, comment, etc, sections generated by gcc */
    /DISCARD/ :{
            *(.note*)
            *(.indent)
            *(.comment)
            *(.stab)
            *(.stabstr)
    }
}
